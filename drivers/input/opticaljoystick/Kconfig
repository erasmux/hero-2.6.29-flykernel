## drivers/input/opticaljoystick/Kconfig
```kconfig
#
# Touchscreen driver configuration
#
menuconfig INPUT_OPTICALJOYSTICK
	bool "Opticaljoystick"
	help
	  Say Y here, and a list of supported optical joystick will be displayed.
	  This option doesn't affect the kernel.

	  If unsure, say Y.

if INPUT_OPTICALJOYSTICK

config OPTICALJOYSTICK_CRUCIAL
	tristate "Crucial Optical Joystick"
	depends on MICROP_COMMON
	help

endif
```

## fake/Kconfig
```kconfig
menuconfig FAKE
	tristate "fake modules"
	default m
if FAKE

config FAKE_SDIO
	tristate "fake SDIO"
	default m

config FAKE_TIAP
	tristate "fake TIAP driver"
	default m

endif # FAKE
```
